## chips/bk7258/Kconfig
```kconfig
#
# BK7258 custom chip configuration.
#

if ARCH_CHIP_CUSTOM

menu "BK7258 Configuration"

choice
	prompt "BK7258 image component"
	default BK7258_COMPONENT_CP

config BK7258_COMPONENT_CP
	bool "CP / physical CPU0 component"
	help
		OpenVela CP component. It owns UART0 and releases physical CPU1.

config BK7258_COMPONENT_AP
	bool "AP / physical CPU1+CPU2 component"
	help
		Dual-core OpenVela AP SMP image. It has no physical console and reports
		reset, scheduler progress and heartbeat through SWAP.  With
		CONFIG_SMP=y, physical CPU1 and CPU2 run one NuttX SMP kernel; without
		it, the image degrades to the single-core CPU1 MVP.

endchoice

comment "All-OpenVela CP/AP SRAM contract"

config BK7258_RPMSG_SHM_ADDR
	hex "RPMsg shared-memory base"
	default 0x28064000
	help
		Fixed base of the CP/AP shared carveout. It is reserved even while
		CONFIG_RPTUN is disabled, so enabling AMP never moves a previously
		validated AP heap, stack or section.

		The all-OpenVela tuple reclaims the locked AI firmware's 108 KiB
		HARDWARE_ACC region for AP RAM, gives AP 0x28010000..0x28064000,
		then reserves 0x28064000..0x2806ec00 for RPMsg. The CP window remains
		unchanged at 0x2806ec00..0x2809f700.

config BK7258_RPMSG_SHM_SIZE
	hex "RPMsg shared-memory size"
	default 0xac00
	help
		43 KiB fixed reservation for the RPTUN resource table, two VirtIO
		vrings and the RPMsg buffer pool. Descriptor and buffer tuning may use
		less than this reservation, but must not move either boundary.

config ARCH_CHIP_BK7258
	bool "Beken BK7258 CP / CPU0"
	default y
	select ARCH_CORTEXM33
	select ARCH_HAVE_MPU
	select ARM_HAVE_MPU_UNIFIED
	select ARCH_HAVE_FPU if BK7258_HARD_FLOAT
	select ARCH_HAVE_TRUSTZONE
	select ARCH_HAVE_MULTICPU
	# Hardware TRNG at 0x458c0000; chips/bk7258/bk7258_trng.c supplies
	# devurandom_register() for it (see CONFIG_DEV_URANDOM_ARCH).
	select ARCH_HAVE_RNG
	select ARMV8M_HAVE_DCACHE
	select ARMV8M_HAVE_ICACHE
	select ARM_SYSTICK
	select TIMER
	select TIMER_ARCH
	select OTHER_UART_SERIALDRIVER if BK7258_COMPONENT_CP
	help
		Secure BK7258 CP/AP support for the locked DevKit profile. CP owns
		UART0; the AP component is a dual-core NuttX SMP image on physical
		CPU1 (logical0) and CPU2 (logical1). CP and the AP SMP domain stay
		separate AMP images. ARCH_HAVE_MULTICPU is selected because the SoC
		exposes three physical cores; the AP defconfig additionally enables
		CONFIG_SMP, while the CP defconfig remains single-core.

		The Cortex-M33 MPU (ARMv8-M, unified) is selected via ARCH_HAVE_MPU
		and ARM_HAVE_MPU_UNIFIED, making CONFIG_ARM_MPU available. BK7258
		boots from an opaque Bootloader that may program the MPU itself, so
		bk7258_mpuinit() resets the MPU and programs a kernel region table
		(flash 0x02000000 WBWA, on-chip SRAM 0x28000000 non-cacheable,
		PSRAM 0x60000000 WBWA, peripherals 0x40000000 device). The
		non-cacheable SRAM attribute is what lets CONFIG_ARMV8M_DCACHE run:
		RPMsg/SWAP/PWR_MNG and the Wi-Fi pbufs live in on-chip SRAM, so they
		stay coherent with MAC/PHY DMA while flash and PSRAM get cached.

config BK7258_HARD_FLOAT
	bool "Enable BK7258 hard-float ABI"
	default n
	help
		Enable the Cortex-M33 FPU and hard-float compiler ABI. This is required
		when linking the vendor Wi-Fi archives, but remains independently
		selectable for PSRAM startup controls so FPU effects can be tested
		without linking Wi-Fi.

config BK7258_SYSTICK_CLOCK_HZ
	int "Secure SysTick clock frequency"
	default 32000
	range 1000 1000000
	help
		The locked vendor CP enables CPU0's external 32 kHz SysTick source.
		The first Flash cold-boot test must validate the frequency and time
		base behavior before any timing acceptance claim.

config BK7258_AP_CPU_CLOCK_HZ
	int "AP CPU core clock frequency (SysTick CLKSOURCE=1 reference)"
	depends on BK7258_COMPONENT_AP
	default 60000000
	range 1000000 1000000000
	help
		Both AP cores (physical CPU1 and CPU2) run their system tick from
		the processor clock (SysTick CLKSOURCE=1).  The board bring-up on
		2026-10-12 measured the effective tick supply at roughly one tenth
		of the configured rate when CPU1 used the external 32 kHz selector,
		so both cores now share this core-clock frequency, which must match
		the SysTick supply clock that the secure Bootloader programmed.
		On-target measurement (2026-10-14, watch v2) read the SYS clock
		registers as cksel_core=3 (480 MHz source) with clkdiv_core=7
		(divide by 8), i.e. a 60 MHz core clock; CPU1's SysTick counted at
		1875 Hz against a reload of 31999, matching this 60 MHz tap, while
		CPU2 (speed bit set, /2) counts at half that rate.  A 60000000
		default makes CPU1's SysTick tick at exactly 1000 Hz; CPU2 keeps
		its /2 clock and therefore ticks at 500 Hz, which only halves its
		round-robin timeslice granularity and is accepted for bring-up.

config BK7258_TIMER0
	bool "BK7258 Timer0 lower-half"
	depends on BK7258_COMPONENT_CP
	depends on TIMER
	default y
	help
		Register the CP-owned BK7258 Timer0 channel as the standard NuttX
		/dev/timer0 lower-half. Timer0 is a shared SoC resource and must not
		be enabled independently by the AP image.

config BK7258_PSRAM
	bool "Initialize DevKit PSRAM as an additional heap"
	depends on MM_REGIONS > 1
	default y
	help
		Initialize the PSRAM fitted to the BK7258 DevKit and add the detected
		memory window to the ordinary NuttX user heap as a second region.

		The driver probes only the APS6408L (8 MiB) and APS128XXO-OB9 (16 MiB)
		command sequences verified in Armino's BK7258 CP implementation. It
		uses internal SRAM until initialization and a mapped-memory probe
		succeed. A missing, unsupported, or failing device leaves the system
		running on its internal-SRAM heap.

		PSRAM is not used for startup, linker sections, executable code, RPMsg,
		or shared-memory regions. It is added to the ordinary NuttX heap, so
		allocation placement is not type-aware: callers requiring internal SRAM
		or DMA-safe memory must use a dedicated allocator when one is available.

config BK7258_PSRAM_PROBE_SIZE
	int "PSRAM mapped-memory probe size"
	depends on BK7258_PSRAM
	default 10240
	range 64 65536
	help
		Number of bytes tested at the beginning of the mapped PSRAM window
		before that window is exposed to the NuttX allocator. The probe checks
		word access and three distinct data patterns, then restores its saved
		contents.

config BK7258_MAILBOX
	bool "BK7258 Mailbox v2 doorbell"
	depends on RPTUN
	default y
	help
		Enable the chip-level Mailbox v2 FIFO and IRQ transport used as the
		RPTUN doorbell. RPMsg payloads remain in shared SRAM; Mailbox carries
		only a notification token.

config BK7258_MAILBOX_IRQ_PRIORITY
	int "Mailbox interrupt priority"
	depends on BK7258_MAILBOX
	default 128
	range 0 255

config BK7258_MB_IPC_RPMSG
	bool "Armino mailbox IPC protocol over RPMsg"
	depends on BK7258_MAILBOX && RPTUN
	default y
	help
		Compile the role-specific Armino mailbox_channel and mb_ipc state
		machines with a BK7258 RPMsg backend. Mailbox v2 remains the RPTUN
		doorbell; authority commands and copied payloads travel over a dedicated
		RPMsg endpoint. This option does not independently enable PHY or SARADC
		multi-core feature macros.

config BK7258_UART0_BAUD
	int "UART0 console baud"
	default 115200
	range 1200 6000000

config BK7258_UART0_CLOCK_HZ
	int "UART0 source clock"
	default 26000000
	range 1000000 100000000

config BK7258_UART0_RXBUFSIZE
	int "UART0 receive buffer size"
	default 128
	range 16 1024

config BK7258_UART0_TXBUFSIZE
	int "UART0 transmit buffer size"
	default 128
	range 16 1024

config BK7258_SPI
	bool
	default n
	select SPI
	help
		Enable the BK7258 SPI controller port (bk7258_spi_hw.c board
		lower-half).  Currently used to drive the LCD1 display FPC through
		the SPI1 master on GPIO2/3/4/5.  Selected by the board LCD1 SPI
		transport choice.

config BK7258_GDMA
	bool "BK7258 GDMA0 controller"
	depends on BK7258_COMPONENT_CP
	select ARCH_DMA
	help
		Enable the CPU0/CP GDMA0 controller.  The initial implementation
		supports only one-shot memory-to-memory transfers on channels 0..7.
		It does not change the SPI/LCD transfer path.

config BK7258_GDMA_TEST
	bool
	depends on BK7258_GDMA
	help
		Internal marker selected by the Kconfig-gated SRAM validation command.

config AUDIO_BK7258
	bool "BK7258 audio device"
	default n
	depends on ARCH_CHIP_BK7258
	select AUDIO
	select AUDIO_FORMAT_PCM
	select SCHED_LPWORK
	---help---
		Enable the BK7258 audio driver for playback (/dev/audio/pcm0p)
		and capture (/dev/audio/pcm0c) using the Beken HAL ADC/DAC APIs.

if AUDIO_BK7258

config AUDIO_BK7258_CAPTURE
	bool "Register BK7258 capture device (/dev/audio/pcm0c)"
	default n
	---help---
		Register a capture (ADC) audio device.  Leave disabled on boards
		without a microphone so the current playback-only bring-up is not
		misinterpreted as recording-capable.

endif # AUDIO_BK7258

config BK7258_WIFI_ARMINO_BASELINE
	bool "BK7258 Wi-Fi: compile the Armino iperf baseline as-is (phase one)"
	default n
	depends on BK7258_COMPONENT_CP
	help
		Phase one of docs/compose/spec/bk7258-wifi-native.md: build the CP
		compile units of the Armino iperf baseline unchanged, one static
		library per Armino component, from the manifest in
		chips/bk7258/tools/armino_baseline. The imported Armino tree is
		chips/bk7258/armino_baseline (T19); override with the
		BK7258_ARMINO_BASELINE_DIR CMake variable or environment variable
		only when regenerating the manifest.

config BK7258_NETBUF_ARENA_SIZE
	hex "Armino Wi-Fi packet buffer arena size (bytes)"
	default 0x10000
	depends on BK7258_WIFI_ARMINO_BASELINE
	help
		Static SRAM arena behind the Armino Wi-Fi driver's packet buffers
		(chips/bk7258/wifi_armino/compat/bk7258_netbuf.c: lwIP's struct
		pbuf, its allocator and its helpers on one private arena).

		The MAC's TX DMA cannot read PSRAM, so pbuf payloads must come from
		SRAM. That rules out the NuttX kernel heap on the CP, which spans the
		5 MiB PSRAM heap and whose SRAM fallback is small and consumed by
		Armino's own os_malloc() calls; a pbuf allocated there can land in
		PSRAM and the first TX frame fails with ac3_tx_dma_dead. A dedicated
		arena keeps pbuf memory in SRAM and bounded.

		Size is set by the frame cost, not by a pool count: one pbuf is
		round_up(sizeof(struct pbuf) + 708 headroom, 4) + payload, i.e.
		~724 B + frame, and rwnx_start_xmit() allocates a second pbuf and
		copies every TX frame into it, so a full-size frame in flight costs
		~2 x 2238 B. 64 KiB is ~23 such frames -- enough for a 64 KiB TCP
		window. At 32 KiB the next pbuf_alloc() returned NULL under TCP
		load and armino_transmit() logged "Transmit failed: -12".

endmenu

endif
```

## chips/bk7258/wifi/Kconfig
```kconfig
#
# chips/bk7258/wifi/Kconfig
#
# BK7258 Wi-Fi skeleton configuration. The MAC/PHY/RF runtime is an external
# vendor input; these symbols select the team-owned NuttX integration only.
# Vendor library path/hash and Beken patch metadata are tracked in
# beken_patch_manifest.md, not here.

menu "BK7258 Wi-Fi"

config BK7258_WIFI
	bool "BK7258 Wi-Fi (NuttX lower-half skeleton)"
	default n
	depends on BK7258_COMPONENT_CP
	depends on NET
	depends on NETDEVICES
	select DRIVERS_WIRELESS
	select NETDEV_WIRELESS_IOCTL
	select NETDEV_WIRELESS_HANDLER
	select DRIVERS_IEEE80211
	select SCHED_HPWORK
	select SCHED_LPWORK
	select ARCH_HAVE_NETDEV_STATISTICS
	help
		Team-owned BK7258 Wi-Fi integration: netdev_lowerhalf +
		wireless_ops_s data/control plane over the Beken MAC/PHY/RF runtime.
		This is a skeleton milestone; it does not link the vendor library
		until a NuttX-buildable vendor library and ABI are available. The
		high-priority worker runs vendor HISR/timer bottom halves; the
		low-priority worker runs the periodic SARADC/PHY temperature task.

if BK7258_WIFI

config BK7258_WIFI_STA
	bool "Wi-Fi station (STA) support"
	default y
	help
		Enable station mode skeleton. SoftAP/P2P/monitor are out of scope
		for the first milestone.

config BK7258_WIFI_AP
	bool "BK7258 Wi-Fi SoftAP support"
	default n
	depends on BK7258_WIFI
	help
		Enable the separate SoftAP provider closure. Keep disabled while the
		STA scan/connect milestone is being brought up.

config BK7258_WIFI_OSAL
	bool "BK7258 Wi-Fi OSAL (NuttX mapping)"
	default y
	help
		Thin wrappers mapping thread/queue/timer/lock/irq/memory onto NuttX
		primitives. Must not create a second scheduler and must not provide
		semantic-empty stubs.

config BK7258_WIFI_VENDOR_PACKET
	bool "BK7258 vendor packet shim"
	default y
	help
		Minimal packet container satisfying the Beken MAC data-path contract
		(next/payload/len/tot_len + private reserve). Distinct from netpkt;
		the lower half converts at the boundary.

config BK7258_WIFI_DEBUG
	bool "BK7258 Wi-Fi skeleton debug logging"
	default n
	depends on DEBUG_FEATURES
	help
		Enable skeleton-stage diagnostics. Must not print passphrase/PMK.

config BK7258_WIFI_VENDOR_LINK
	bool "Link BK7258 vendor Wi-Fi/PHY archives"
	default n
	depends on BK7258_WIFI
	help
		Add the pinned libwifi.a and libbk_phy.a archives to the link.
		This option only brings in the archives; starting the runtime is
		the separate BK7258_WIFI_VENDOR_RUNTIME switch. Do not enable
		this one alone: rw_msg_rx.c is compiled unconditionally and calls
		wpa_clear_scan_results(), which lives in hostapd_intf.c and is
		only compiled under VENDOR_RUNTIME, so LINK=y with RUNTIME=n
		fails to link.

config BK7258_WIFI_VENDOR_RUNTIME
	bool "Start BK7258 vendor Wi-Fi runtime"
	default n
	depends on BK7258_WIFI_VENDOR_LINK
	help
		Compile the vendor runtime and its WPA closure. The BK7258
		board starts it before userspace from a dedicated large-stack
		worker. User-space control is through the standard wapi CLI.

config BK7258_WIFI_WPA_TASK_PRIORITY
	int "WPA task priority"
	default 5
	depends on BK7258_WIFI_VENDOR_RUNTIME
	help
		Armino logical WPA task priority. Its public RTOS API reverses the
		FreeRTOS-native 0..9 priority range, while NuttX uses increasing
		numeric priorities directly. The OSAL therefore reverses this
		logical value while projecting it onto the NuttX scheduler range.

comment "Vendor packet private reserve (beken_genie BK7258 profile)"

config BK7258_WIFI_MSDU_RESV_HEAD_LENGTH
	int "MSDU reserve head length"
	default 108
	depends on BK7258_WIFI_VENDOR_PACKET
	help
		MAC headroom before the Ethernet payload. Locked beken_genie profile
		value; treat as a versioned vendor input, not a silicon constant.

config BK7258_WIFI_MSDU_RESV_DESC_LENGTH
	int "MSDU reserve descriptor length"
	default 600
	depends on BK7258_WIFI_VENDOR_PACKET
	help
		Descriptor private area holding sk_buff + tx descriptor + SG entries.
		The lower half and packet shim must verify that these reserves are
		not exceeded at runtime.

endif # BK7258_WIFI

endmenu
```
