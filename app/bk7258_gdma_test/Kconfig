## app/bk7258_gdma_test/Kconfig
```kconfig
config LVX_USE_DEMO_CONTEST2026_272_BK7258_GDMA_TEST
  bool "BK7258 GDMA SRAM validation command"
  depends on ARCH_CHIP_BK7258 && BK7258_GDMA
  select BK7258_GDMA_TEST
  default n
  ---help---
    Enable the manually-invoked bk7258_gdma_test NSH command.  The command
    validates one GDMA0 memory-to-memory transfer using static SRAM buffers.
```

## app/bk7258_platform_test/Kconfig
```kconfig
config LVX_USE_DEMO_CONTEST2026_272_BK7258_PLATFORM_TEST
  bool "BK7258 platform API test"
  default n
  ---help---
    Enable the manually-invoked BK7258 platform clock, power, IRQ and
    TXEN/RXEN mux readback test.
```

## app/deskmate/Kconfig
```kconfig
config LVX_USE_DEMO_CONTEST2026_272_DESKMATE
	bool "DeskMate device client (contest team 272)"
	depends on NETUTILS_MQTTC && NETUTILS_CJSON
	default n
	---help---
		Enable the DeskMate MQTT device client. Broker address and credentials
		are supplied when the app starts and are never stored in firmware logs.
```

## board/bk7258-devkit/Kconfig
```kconfig
# BK7258 DevKit board configuration.

config ARCH_BOARD_BK7258_DEVKIT
	bool
	default y

if ARCH_BOARD_BK7258_DEVKIT

config ARCH_BOARD_BK7258_DEVKIT_TAG
	string "Board tag"
	default "bk7258-devkit"

comment "CP/AP/RPMsg SRAM contract is defined by the BK7258 chip configuration"

config ARCH_BOARD_BK7258_DEVKIT_BUTTONS
	bool "Enable board button support"
	depends on BK7258_COMPONENT_AP
	default y
	select ARCH_HAVE_BUTTONS
	select ARCH_HAVE_IRQBUTTONS
	---help---
		Enable the three buttons (KEY1/KEY2/KEY3) on the BK7258 DevKit.
		KEY1=GPIO13, KEY2=GPIO12, KEY3=GPIO8, all active-low with
		internal pull-up.

endif # ARCH_BOARD_BK7258_DEVKIT

if LCD_JD9853 || LCD_GC9D01

choice
	prompt "LCD1 display SPI transport"
	default BK7258_LCD1_SPI_BITBANG
	help
		The LCD1 display FPC ("QSPI1" net, GPIO2/3/4/5) can be driven by
		the SoC SPI1 controller or by a GPIO bit-bang lower-half.  The
		bit-bang path is the default: it is the only one verified to boot
		on hardware so far.  The hardware SPI1 master is much faster but
		its register access / pinmux is still under bring-up and will hang
		the board if the SPI1 controller is not reachable from CPU0.

config BK7258_LCD1_SPI_HW
	bool "SoC SPI1 controller"
	select BK7258_SPI
	select SPI_CMDDATA
	---help---
		Drive the LCD1 display FPC through the SPI1 master (GPIO2=SCK,
		GPIO4=MOSI; CS=GPIO3 and D/C=GPIO5 stay plain GPIOs).  This uses
		the ARMINO-derived SPI1 port in src/bk7258_spi_hw.c.

config BK7258_LCD1_SPI_BITBANG
	bool "GPIO bit-bang"
	select SPI_BITBANG
	select SPI_CMDDATA
	---help---
		Fall back to the original GPIO bit-bang lower-half
		(src/bk7258_spi_bitbang.c).  Only selected for bring-up when the
		SPI1 controller path misbehaves.

endchoice

# NOTE: the two lower-halves are compiled against the *choice* symbols
# (BK7258_LCD1_SPI_HW / BK7258_LCD1_SPI_BITBANG) rather than the selected
# infrastructure symbols.  Kconfig choices can leave a stale "select" from
# the previously chosen member in .config; guarding on the choice symbol
# keeps exactly one bk7258_spi_initialize() in the link even in that state.

endif # LCD_JD9853 || LCD_GC9D01

menuconfig LCD_JD9853
	bool "JD9853 SPI LCD panel"
	default n
	select LCD
	select SPI
	---help---
		Enable the JD9853 (Jadard) 4-wire SPI TFT LCD lower-half driver on
		the DevKit display FPC.  The SCL/SDA/D/C/CS lines are driven
		through the SPI transport selected by the "LCD1 display SPI
		transport" choice (hardware SPI1 by default) and the backlight is
		driven by GPIO25.  Register /dev/lcd0 (CONFIG_LCD_DEV) or
		/dev/fb0 (CONFIG_LCD_FRAMEBUFFER) in board_app_initialize() to
		expose the display to applications.

if LCD_JD9853

config LCD_JD9853_SPIMODE
	int "JD9853 SPI mode"
	default 0
	range 0 3
	---help---
		SPI mode used to talk to the JD9853.  The panel requires Mode 0.

config LCD_JD9853_FREQUENCY
	int "JD9853 SPI frequency (Hz)"
	default 6500000
	---help---
		SPI clock frequency requested for the JD9853 display.  The SPI1
		controller derives the actual rate as 26 MHz / (2 * clk_rate), so
		only ~13/6.5/4.33 MHz steps are reachable on the XTAL source.
		6.5 MHz (clk_rate=2) is the conservative default; raise to
		13000000 (clk_rate=1) if the panel accepts the faster clock.

config LCD_JD9853_XRES
	int "JD9853 horizontal resolution"
	default 240
	---help---
		Visible horizontal resolution in pixel columns.

config LCD_JD9853_YRES
	int "JD9853 vertical resolution"
	default 296
	---help---
		Visible vertical resolution in pixel rows.  The JD9853 RAM window is
		240x320; the T201BM-C12-03 2.01 inch panel exposes 240x296.

config LCD_JD9853_XOFFSET
	int "JD9853 horizontal offset"
	default 0
	---help---
		Horizontal offset of the visible area inside the JD9853 RAM window.

config LCD_JD9853_YOFFSET
	int "JD9853 vertical offset"
	default 0
	---help---
		Vertical offset of the visible area inside the JD9853 RAM window.

config LCD_JD9853_BPP
	int "JD9853 bits-per-pixel"
	default 16
	range 16 16
	---help---
		Color depth in bits-per-pixel.  Only 16 (RGB565) is supported.

config LCD_JD9853_BGR
	bool "JD9853 BGR pixel order"
	default n
	---help---
		Set the panel to BGR color order (MADCTL bit 3).

config LCD_JD9853_TE
	bool "JD9853 tearing effect line"
	default n
	---help---
		Enable the tearing effect output line on the JD9853.

config LCD_JD9853_INVERT
	bool "JD9853 inverted display"
	default n
	---help---
		Enable display inversion for panels wired with an inverted
		polarity.

endif # LCD_JD9853

menuconfig LCD_GC9D01
	bool "GC9D01 SPI LCD panel"
	default n
	select LCD
	select SPI
	---help---
		Enable the GC9D01 4-wire SPI TFT LCD lower-half driver for the
		DevKit's two round 0.71" 160x160 panels.  The SCL/SDA/D/C/CS
		lines are driven through the SPI transport selected by the "LCD1
		display SPI transport" choice (hardware SPI1 by default) and the
		backlight is driven by GPIO25.  Register /dev/lcd0
		(CONFIG_LCD_DEV) or /dev/fb0 (CONFIG_LCD_FRAMEBUFFER) in
		board_app_initialize() to expose the display to applications.

if LCD_GC9D01

config LCD_GC9D01_SPIMODE
	int "GC9D01 SPI mode"
	default 0
	range 0 3
	---help---
		SPI mode used to talk to the GC9D01.  The panel requires Mode 0.

config LCD_GC9D01_FREQUENCY
	int "GC9D01 SPI frequency (Hz)"
	default 13000000
	---help---
		SPI clock frequency requested for the GC9D01 display.  The SPI1
		controller derives the actual rate as 26 MHz / (2 * clk_rate), so
		only ~13/6.5/4.33 MHz steps are reachable on the XTAL source.
		13 MHz (clk_rate=1) is the default for the round panels.

config LCD_GC9D01_XRES
	int "GC9D01 horizontal resolution"
	default 160
	---help---
		Visible horizontal resolution in pixel columns.

config LCD_GC9D01_YRES
	int "GC9D01 vertical resolution"
	default 160
	---help---
		Visible vertical resolution in pixel rows.

config LCD_GC9D01_XOFFSET
	int "GC9D01 horizontal offset"
	default 0
	---help---
		Horizontal offset of the visible area inside the RAM window.

config LCD_GC9D01_YOFFSET
	int "GC9D01 vertical offset"
	default 0
	---help---
		Vertical offset of the visible area inside the RAM window.

config LCD_GC9D01_BPP
	int "GC9D01 bits-per-pixel"
	default 16
	range 16 16
	---help---
		Color depth in bits-per-pixel.  Only 16 (RGB565) is supported.

config LCD_GC9D01_BGR
	bool "GC9D01 BGR pixel order"
	default n
	---help---
		Set the panel to BGR color order (MADCTL bit 3).

config LCD_GC9D01_TE
	bool "GC9D01 tearing effect line"
	default n
	---help---
		Enable the tearing effect output line on the GC9D01.

config LCD_GC9D01_INVERT
	bool "GC9D01 inverted display"
	default n
	---help---
		Enable display inversion for panels wired with an inverted
		polarity.

endif # LCD_GC9D01
```

## board/bk7258-devkit/configs/ap-single/defconfig
```kconfig
CONFIG_ARCH="arm"
CONFIG_ARCH_CHIP_ARM_CUSTOM=y
CONFIG_ARCH_CHIP_CUSTOM=y
CONFIG_ARCH_CHIP_CUSTOM_DIR="../vendor/beken/chips/bk7258"
CONFIG_ARCH_CHIP_CUSTOM_DIR_RELPATH=y
CONFIG_ARCH_CHIP_CUSTOM_NAME="bk7258"
CONFIG_ARCH_BOARD_CUSTOM=y
CONFIG_ARCH_BOARD_CUSTOM_DIR="../vendor/beken/boards/bk7258/bk7258-devkit"
CONFIG_ARCH_BOARD_CUSTOM_DIR_RELPATH=y
CONFIG_ARCH_BOARD_CUSTOM_NAME="bk7258-devkit"
CONFIG_ARCH_BOARD_BK7258_DEVKIT=y
CONFIG_ARCH_CHIP_BK7258=y
CONFIG_BK7258_COMPONENT_AP=y
CONFIG_ARCH_TRUSTZONE_SECURE=y
CONFIG_ARCH_IRQPRIO=y
CONFIG_ARCH_INTERRUPTSTACK=2048
CONFIG_ARCH_STACKDUMP=y
CONFIG_ARMV8M_SYSTICK=y
CONFIG_ARMV8M_DCACHE=y
CONFIG_ARMV8M_ICACHE=y
CONFIG_BOARD_EARLY_INITIALIZE=y
CONFIG_BOARD_LATE_INITIALIZE=y
CONFIG_BOARDCTL=y
CONFIG_BUILTIN=y
CONFIG_DEBUG_ASSERTIONS=y
CONFIG_DEBUG_FEATURES=y
CONFIG_DEBUG_HARDFAULT_ALERT=y
CONFIG_DEBUG_MEMFAULT=y
CONFIG_DEBUG_BUSFAULT=y
CONFIG_DEBUG_USAGEFAULT=y
CONFIG_DEBUG_SECUREFAULT=y
CONFIG_DEBUG_SYMBOLS=y
CONFIG_DEV_CONSOLE=y
CONFIG_DEV_SIMPLE_ADDRENV=y
CONFIG_IDLETHREAD_STACKSIZE=8192
CONFIG_INIT_ENTRYPOINT="nsh_main"
CONFIG_INIT_STACKSIZE=8192
CONFIG_INTELHEX_BINARY=y
CONFIG_NSH_BUILTIN_APPS=y
CONFIG_NSH_PROMPT_STRING="nsh-ap> "
CONFIG_NSH_READLINE=y
CONFIG_PREALLOC_TIMERS=4
CONFIG_RAM_SIZE=344064
CONFIG_RAM_START=0x28010000
CONFIG_RAW_BINARY=y
CONFIG_BK7258_MAILBOX=y
CONFIG_RPMSG_LOCAL_CPUNAME="ap"
CONFIG_RPMSG_PING=y
CONFIG_RPMSG_UART=y
CONFIG_RPMSG_UART_CONSOLE=y
CONFIG_RPTUN=y
CONFIG_RPTUN_AUTO_RESET_DISABLE=y
CONFIG_RPTUN_PRIORITY=90
CONFIG_RPTUN_STACKSIZE=4096
CONFIG_RR_INTERVAL=200
CONFIG_SCHED_WAITPID=y
CONFIG_SERIAL=y
CONFIG_START_DAY=1
CONFIG_START_YEAR=2026
CONFIG_TASK_NAME_SIZE=0
CONFIG_SYSTEM_NSH=y
CONFIG_USEC_PER_TICK=1000
CONFIG_FS_PROCFS=y
CONFIG_NSH_ARCHINIT=y
```
